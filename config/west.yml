## config/west.yml
```yaml
manifest:
  remotes:
    - name: zmkfirmware
      url-base: https://github.com/zmkfirmware
    - name: infused-kim
      url-base: https://github.com/infused-kim
    # Additional modules containing boards/shields/custom code can be listed here as well
    # See https://docs.zephyrproject.org/3.2.0/develop/west/manifest.html#projects
  projects:
    - name: zmk-zephyr
      remote: infused-kim
      revision: v2.5.0+zmk-fixes+kim-fixes
      clone-depth: 1
      import:
        # TODO: Rename once upstream offers option like `exclude` or `denylist`
        name-blacklist:
          - ci-tools
          - hal_altera
          - hal_cypress
          - hal_infineon
          - hal_microchip
          - hal_nxp
          - hal_openisa
          - hal_silabs
          - hal_xtensa
          - hal_st
          - hal_ti
          - loramac-node
          - mcuboot
          - mcumgr
          - net-tools
          - segger
          - openthread
          - edtt
          - trusted-firmware-m
    - name: uf2
      remote: microsoft
      path: tools/uf2
      clone-depth: 1
  self:
    west-commands: scripts/west-commands.yml
```
